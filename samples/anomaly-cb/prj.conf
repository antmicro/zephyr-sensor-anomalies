## CMakeLists.txt
```
# Copyright (c) 2026 Antmicro <www.antmicro.com>
#
# SPDX-License-Identifier: Apache-2.0


cmake_minimum_required(VERSION 3.13.1)
find_package(Zephyr REQUIRED HINTS $ENV{ZEPHYR_BASE})

project(app LANGUAGES C)

target_sources(app PRIVATE src/main.c)
```

## Kconfig
```
# Copyright (c) 2026 Antmicro <www.antmicro.com>
#
# SPDX-License-Identifier: Apache-2.0

menu "Zephyr"
source "Kconfig.zephyr"
endmenu

config KENNING_PROTOCOL_INTEGRATION
    bool "Max sum of channels in available sensors"
    default n
    depends on PROVIDER_LIB && ANOMALY_LIB && KENNING_COMMUNICATION_PROTOCOL_UART && KENNING_INFERENCE_LIB

config PROCESSING_DELAY
    int "Expected time [ms] of processing for a single model sample"
    default 50
    depends on PROVIDER_LIB && ANOMALY_LIB

config CLASSIFIER_SAMPLES_BATCHED
    bool "Batch the number of samples when sending to the classifier"
    default n
    depends on PROVIDER_LIB && ANOMALY_LIB

config CLASSIFIER_SAMPLES_BATCHSIZE
    int "Size of each batch when sending to the classifier"
    default 16
    depends on CLASSIFIER_SAMPLES_BATCHED

config MAX_ANOMALY_COUNT
    int "The maximum number of anomalies to be detected before exit during test (default 0 means unlimited)"
    default 0

module = APP
module-str = app
source "subsys/logging/Kconfig.template.log_config"
```

## sample.yaml
```
sample:
  name: anomaly-cb
common:
  platform_allow:
    - stm32f746g_disco
tests:

  sample.anomalycb.kenning.robot:
    extra_configs:
      - CONFIG_CPP=y
      - CONFIG_STD_CPP17=y
      - CONFIG_NEWLIB_LIBC=y
      - CONFIG_NEWLIB_LIBC_NANO=y
      - CONFIG_NEWLIB_LIBC_FLOAT_PRINTF=y
      - CONFIG_MAIN_STACK_SIZE=4096
      - CONFIG_SERIAL=y
      - CONFIG_FPU=y
      - CONFIG_BUILD_WITH_TFM=n
      - CONFIG_HEAP_MEM_POOL_SIZE=2048
      - CONFIG_KENNING_INFERENCE_LIB=y
      - CONFIG_KENNING_ML_RUNTIME_TFLITE=y
      - CONFIG_KENNING_TFLITE_BUFFER_SIZE=40
      - CONFIG_ANOMALY_LIB_BACKEND_KENNING=y
      - CONFIG_KENNING_MODEL_PATH="kenning_tflite_model.tflite"
    harness: robot
    harness_config:
      robot_testsuite: kenning.robot
  sample.anomalycb.kenningbatched.robot:
    extra_configs:
      - CONFIG_CPP=y
      - CONFIG_STD_CPP17=y
      - CONFIG_NEWLIB_LIBC=y
      - CONFIG_NEWLIB_LIBC_NANO=y
      - CONFIG_NEWLIB_LIBC_FLOAT_PRINTF=y
      - CONFIG_MAIN_STACK_SIZE=4096
      - CONFIG_SERIAL=y
      - CONFIG_FPU=y
      - CONFIG_BUILD_WITH_TFM=n
      - CONFIG_HEAP_MEM_POOL_SIZE=2048
      - CONFIG_KENNING_INFERENCE_LIB=y
      - CONFIG_KENNING_ML_RUNTIME_TFLITE=y
      - CONFIG_KENNING_TFLITE_BUFFER_SIZE=40
      - CONFIG_ANOMALY_LIB_BACKEND_KENNING=y
      - CONFIG_KENNING_MODEL_PATH="kenning_tflite_model.tflite"
      - CONFIG_CLASSIFIER_SAMPLES_BATCHED=y
    harness: robot
    harness_config:
      robot_testsuite: kenning.robot
```

## prj.conf
```kconfig
# Copyright (c) 2025 Antmicro <www.antmicro.com>
#
# SPDX-License-Identifier: Apache-2.0


CONFIG_SENSOR=y
CONFIG_PROVIDER_LIB=y
CONFIG_ANOMALY_LIB=y
CONFIG_LIS2DS12=y
CONFIG_CBPRINTF_FP_SUPPORT=y
```

## kenning.conf
```kconfig
# Copyright (c) 2026 Antmicro <www.antmicro.com>
#
# SPDX-License-Identifier: Apache-2.0


CONFIG_CPP=y
CONFIG_STD_CPP17=y
CONFIG_NEWLIB_LIBC=y
CONFIG_NEWLIB_LIBC_NANO=y
CONFIG_NEWLIB_LIBC_FLOAT_PRINTF=y
CONFIG_MAIN_STACK_SIZE=4096
CONFIG_SERIAL=y
CONFIG_FPU=y
CONFIG_BUILD_WITH_TFM=n
CONFIG_HEAP_MEM_POOL_SIZE=2048

CONFIG_KENNING_INFERENCE_LIB=y
CONFIG_KENNING_ML_RUNTIME_TFLITE=y
CONFIG_KENNING_TFLITE_BUFFER_SIZE=64

CONFIG_ANOMALY_LIB_BACKEND_KENNING=y
CONFIG_KENNING_COMMUNICATION_PROTOCOL_UART=y
CONFIG_KENNING_PROTOCOL_INTEGRATION=y

CONFIG_ANOMALY_LIB_KENNING_MAX_INPUT_COUNT=256
```

## kenningbatched.conf
```kconfig
# Copyright (c) 2025 Antmicro <www.antmicro.com>
#
# SPDX-License-Identifier: Apache-2.0


CONFIG_CPP=y
CONFIG_STD_CPP17=y
CONFIG_NEWLIB_LIBC=y
CONFIG_NEWLIB_LIBC_NANO=y
CONFIG_NEWLIB_LIBC_FLOAT_PRINTF=y
CONFIG_MAIN_STACK_SIZE=4096
CONFIG_SERIAL=y
CONFIG_FPU=y
CONFIG_BUILD_WITH_TFM=n
CONFIG_HEAP_MEM_POOL_SIZE=2048

CONFIG_KENNING_INFERENCE_LIB=y
CONFIG_KENNING_ML_RUNTIME_TFLITE=y
CONFIG_KENNING_TFLITE_BUFFER_SIZE=64

CONFIG_ANOMALY_LIB_BACKEND_KENNING=y
CONFIG_KENNING_COMMUNICATION_PROTOCOL_UART=y
CONFIG_KENNING_PROTOCOL_INTEGRATION=y

CONFIG_ANOMALY_LIB_KENNING_MAX_INPUT_COUNT=256
CONFIG_CLASSIFIER_SAMPLES_BATCHED=y
```

## src/main.c
```c
/*
 * Copyright (c) 2026 Antmicro <www.antmicro.com>
 *
 * SPDX-License-Identifier: Apache-2.0
 */

#include "kenning_inference_lib/core/protocol.h"
#include "zephyr/toolchain.h"
#include <zephyr/kernel.h>

#include <stdatomic.h>
#include <stdio.h>
#include <string.h>

#include <anomaly_lib/detector.h>
#include <provider_lib/provider.h>
#include <provider_lib/providers/sensor.h>

#include <kenning_inference_lib/core/kenning_protocol.h>
#include <kenning_inference_lib/core/loaders.h>

#ifdef CONFIG_KENNING_PROTOCOL_INTEGRATION

struct msg_loader *msg_loader_picker(message_type_t type)
{
    static uint8_t payload_buffer[128];
    static struct msg_loader ldr = MSG_LOADER_BUF(payload_buffer, sizeof(payload_buffer));
    return &ldr;
}

/**
 * Initializes the Kenning protocol and performs the handshake.
 */
int initialize_protocol()
{
    int status;

    status = protocol_init();
    if (status)
    {
        printk("Protocol init failed: %d\n", status);
        return status;
    }

    protocol_event_t recv_event;

    status = protocol_listen(&recv_event, msg_loader_picker);

    if (status)
    {
        printk("Protocol listen failed: %d\n", status);
        return status;
    }

    if (recv_event.message_type != MESSAGE_TYPE_PING || !recv_event.flags.general_purpose_flags.success)
    {
        printk("Invalid message received");
        return -1;
    }

    protocol_event_t send_event = {0};
    send_event.flags.general_purpose_flags.success = 1;
    send_event.message_type = MESSAGE_TYPE_PING;
    send_event.payload.size = 0;

    status = protocol_transmit(&send_event);

    if (status)
    {
        printk("Failed to respond: %d\n", status);
        return status;
    }

    return 0;
}
#else
int initialize_protocol() { return -1; }
#endif // CONFIG_KENNING_PROTOCOL_INTEGRATION

#ifdef CONFIG_KENNING_PROTOCOL_INTEGRATION

/**
 * Sends results via Kenning protocol.
 */
int send_score(float score)
{
    static float output_buffer[128];
    output_buffer[0] = score;
    output_buffer[1] = 1 - score;

    protocol_event_t send_event = {0};
    send_event.flags.general_purpose_flags.success = 1;
    send_event.message_type = MESSAGE_TYPE_OUTPUT;
    send_event.payload.size = 2 * sizeof(float);
    send_event.payload.raw_bytes = (uint8_t *)output_buffer;

    protocol_transmit(&send_event);
}
#else
int send_score(float score) { return 0; }
#endif // CONFIG_KENNING_PROTOCOL_INTEGRATION

static void log_score_cb(void *ctx, float score) { printf("Anomaly detected with probability %.5f\n", (double)score); }
static void send_score_cb(void *ctx, float score)
{
    int protocol_initialized = *((int *)ctx);
    if (protocol_initialized)
    {
        send_score(score);
    }
}

#if CONFIG_MAX_ANOMALY_COUNT > 0
static void anomaly_ctr_cb(void *ctx, float _score)
{
    ARG_UNUSED(_score);
    // When anomaly reaches 4 counts, stop detecting more.
    atomic_inc((atomic_t *)ctx);
}
#endif // CONFIG_MAX_ANOMALY_COUNT

int main()
{
    int status;
#if CONFIG_MAX_ANOMALY_COUNT > 0
    atomic_t anomaly_ctr = ATOMIC_INIT(0);
#endif // CONFIG_MAX_ANOMALY_COUNT

    static struct provider_reader pr = {
        .dst_N = 0,
        .ps_N = 0,
    };

    static struct provider_hdr_entry hdr[128];

    status = provider_reader_register_all_sensor(&pr);
    if (status)
    {
        printk("Sensor registration failed: %d\n", status);
        return -1;
    }

    status = provider_reader_hdr(&pr, hdr);
    if (status)
    {
        printk("Header generation failed: %d\n", status);
        return -1;
    }

    int protocol_initialized = !initialize_protocol();

    status = detector_init();
    if (status)
    {
        printk("Detector init failed: %d\n", status);
        return -1;
    }

    struct detector_classifier dc = {0};

    status = detector_classifier_init(&g_detector, &dc, &pr, 100, 0.5);
    if (status)
    {
        printk("Classifier init failed: %d\n", status);
        return -1;
    }

    status = detector_classifier_register_cb(&dc, log_score_cb, NULL);
    if (status)
    {
        printk("Failed to register log_score_cb: %d\n", status);
        return -1;
    }

    status = detector_classifier_register_cb(&dc, send_score_cb, (void *)&protocol_initialized);
    if (status)
    {
        printk("Failed to register send_score_cb: %d\n", status);
        return -1;
    }

#if CONFIG_MAX_ANOMALY_COUNT > 0
    status = detector_classifier_register_cb(&dc, anomaly_ctr_cb, (void *)&anomaly_ctr);
    if (status)
    {
        printk("Failed to register anomaly_ctr_cb: %d\n", status);
    }
#endif // CONFIG_MAX_ANOMALY_COUNT

    status = detector_classifier_start(&dc, 6, DETECTOR_DEFAULT_OPTS);
    if (status)
    {
        printk("Failed to start classifier: %d\n", status);
        return -1;
    }

#if CONFIG_MAX_ANOMALY_COUNT > 0
    while (atomic_get(&anomaly_ctr) < CONFIG_MAX_ANOMALY_COUNT)
    {
        k_msleep(10);
    }

    detector_classifier_deinit(&dc);
    printk("Successfully shut down classifier\n");
#else
    while (1)
    {
        k_msleep(1000);
    }
#endif // CONFIG_MAX_ANOMALY_COUNT
}
```
