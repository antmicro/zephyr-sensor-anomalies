## lib/Kconfig
```kconfig
# Copyright (c) 2025 Antmicro <www.antmicro.com>
#
# SPDX-License-Identifier: Apache-2.0

menu "Libraries"

rsource "provider_lib/Kconfig"

rsource "anomaly_lib/Kconfig"

endmenu
```

## lib/anomaly_lib/Kconfig
```kconfig
# Copyright (c) 2025 Antmicro <www.antmicro.com>
#
# SPDX-License-Identifier: Apache-2.0

config ANOMALY_LIB
    bool "Support for anomaly lib"

choice ANOMALY_LIB_BACKEND
    prompt "Backend used for anomaly detection"
    depends on ANOMALY_LIB
    default ANOMALY_LIB_BACKEND_NONE

config ANOMALY_LIB_BACKEND_NONE
    prompt "no backend"
    bool

config ANOMALY_LIB_BACKEND_EMLEARN
    prompt "emlearn-based backend"
    bool
    depends on EMLEARN

config ANOMALY_LIB_BACKEND_KENNING
    prompt "kenning-based backend"
    bool
    depends on KENNING_INFERENCE_LIB

endchoice

config ANOMALY_LIB_EMLEARN_MODEL_PATH
    prompt "emlearn model path"
    string
    depends on ANOMALY_LIB_BACKEND_EMLEARN

config ANOMALY_LIB_EMLEARN_THRESHOLD
    prompt "emlearn threshold"
    int
    default 50000
    depends on ANOMALY_LIB_BACKEND_EMLEARN

config ANOMALY_LIB_KENNING_MAX_INPUT_COUNT
    prompt "kenning backend maximum input count"
    int
    default 32
    depends on ANOMALY_LIB_BACKEND_KENNING

config ANOMALY_LIB_KENNING_MAX_OUTPUT_COUNT
    prompt "kenning backend maximum output count"
    int
    default 32
    depends on ANOMALY_LIB_BACKEND_KENNING

config ANOMALY_LIB_DETECTION_CALLBACKS
    prompt "callback-based anomaly detection handling"
    bool
    default y

config ANOMALY_LIB_DETECTION_CALLBACKS_STACKSIZE
    prompt "stack size for each thread spawned"
    int
    default 2048
    depends on ANOMALY_LIB_DETECTION_CALLBACKS

config ANOMALY_LIB_DETECTION_CALLBACKS_MAX_CB_HDLRS
    prompt "maximum number of callback handlers allowed"
    int
    default 8
    depends on ANOMALY_LIB_DETECTION_CALLBACKS

config ANOMALY_LIB_DETECTION_CALLBACKS_WORK_Q_RINGBUF_SIZE
    prompt "size of the ring buffer for callback work queues"
    int
    default 128
    depends on ANOMALY_LIB_DETECTION_CALLBACKS

config ANOMALY_LIB_DETECTION_CALLBACKS_HEAPSIZE
    prompt "size of the heap for callback work queues"
    int
    default 2048
    depends on ANOMALY_LIB_DETECTION_CALLBACKS
```

## lib/provider_lib/Kconfig
```kconfig
# Copyright (c) 2025 Antmicro <www.antmicro.com>
#
# SPDX-License-Identifier: Apache-2.0

config PROVIDER_LIB
    bool "Support for provider lib"

config MAX_PROVIDER_COUNT
    int "Maximum number of providers"
    default 16
    depends on PROVIDER_LIB
```

## west.yml
```yaml
manifest:
  self:
    west-commands: scripts/west-commands.yml

  remotes:
    - name: zephyrproject-rtos
      url-base: https://github.com/zephyrproject-rtos

  projects:
    - name: zephyr
      remote: zephyrproject-rtos
      revision: main
      import:
        name-allowlist:
          - cmsis_6
          - hal_adi
          - hal_stm32
          - hal_st

    - name: emlearn
      url: https://github.com/emlearn/emlearn
      revision: master
```
